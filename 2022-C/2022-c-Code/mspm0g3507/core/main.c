/*
┌─────────────────────────────────────────────────────────────────────────────┐
│                         MSPM0G3507 完整资源占用表                            │
│                        (Texas Instruments MSPM0G3507)                       │
├─────────────────────────────────────────────────────────────────────────────┤
│ 串口资源 (UART) - Universal Asynchronous Receiver/Transmitter               │
├─────────┬─────────┬─────────┬─────────────────────────────────────────────┤
│ 串口号  │   TX    │   RX    │              用途/模块                       │
├─────────┼─────────┼─────────┼─────────────────────────────────────────────┤
│ UART_0  │  PA10   │  PA11   │  系统调试串口/蓝牙模块 (115200 bps)         │
│ UART_1  │  PB2    │  PB3    │  维特陀螺仪通信 (9600 bps)                  │
└─────────┴─────────┴─────────┴─────────────────────────────────────────────┘

┌─────────────────────────────────────────────────────────────────────────────┐
│ GPIO资源 (General Purpose Input/Output) - 数字输入输出                      │
├─────────┬─────────┬─────────────────────────────────────────────────────────┤
│  引脚   │  功能   │                   用途                                   │
├─────────┼─────────┼─────────────────────────────────────────────────────────┤
│         │  LED指示灯 (输出)                                                 │
│  PB26   │ LED_R   │  红色LED指示灯 (低电平点亮)                             │
│  PB27   │ LED_G   │  绿色LED指示灯 (低电平点亮)                             │
│  PB22   │ LED_B   │  蓝色LED指示灯 (低电平点亮)                             │
├─────────┼─────────┼─────────────────────────────────────────────────────────┤
│         │  OLED显示屏控制 (输出)                                           │
│  PB16   │OLED_RST │  OLED显示屏复位信号 (低电平有效)                        │
│  PB17   │OLED_DC  │  OLED显示屏数据/命令选择 (H:数据, L:命令)                │
│  PB20   │OLED_CS  │  OLED显示屏片选信号 (低电平有效)                        │
├─────────┼─────────┼─────────────────────────────────────────────────────────┤
│         │  用户按键 (输入, 低电平有效)                                     │
│  PB12   │  KEY1   │  按键1 (外部下拉电阻)                                  │
│  PB8    │  KEY2   │  按键2 (内部上拉电阻使能)                              │
│  PB9    │  KEY3   │  按键3 (外部下拉电阻)                                  │
│  PB10   │  KEY4   │  按键4 (外部下拉电阻)                                  │
├─────────┼─────────┼─────────────────────────────────────────────────────────┤
│         │  旋转编码器 (中断输入, 双边沿触发)                               │
│  PB4    │ENCODER_1│  编码器通道1 (A相/B相)                                  │
│  PB5    │ENCODER_2│  编码器通道2 (A相/B相)                                  │
│  PB6    │ENCODER_3│  编码器通道3 (A相/B相)                                  │
│  PB7    │ENCODER_4│  编码器通道4 (A相/B相)                                  │
│  PB19   │ENCODER_5│  编码器通道5 (A相/B相)                                  │
│  PB18   │ENCODER_6│  编码器通道6 (A相/B相)                                  │
│  PB23   │ENCODER_7│  编码器通道7 (A相/B相)                                  │
│  PB13   │ENCODER_8│  编码器通道8 (A相/B相)                                  │
├─────────┼─────────┼─────────────────────────────────────────────────────────┤
│         │  74HC595移位寄存器控制 (输出扩展)                                │
│  PA25   │HC595_DS │  74HC595串行数据输入 (Serial Data Input)                │
│  PA15   │HC595_SHCP│ 74HC595移位寄存器时钟 (Shift Register Clock)          │
│  PA14   │HC595_STCP│ 74HC595存储寄存器时钟 (Storage Register Clock)        │
└─────────┴─────────┴─────────────────────────────────────────────────────────┘

┌─────────────────────────────────────────────────────────────────────────────┐
│ I2C资源 (Inter-Integrated Circuit) - 双线串行总线                           │
├─────────┬─────────┬─────────┬─────────────────────────────────────────────┤
│ I2C总线 │  SCL    │  SDA    │              用途/设备                       │
├─────────┼─────────┼─────────┼─────────────────────────────────────────────┤
│  I2C1   │  PA12   │  PA13   │  PCA9555 GPIO扩展器 (16位I/O扩展)           │
│  I2C2   │  PA8    │  PA26   │  MPU6050六轴陀螺仪 + VL53L1X激光测距传感器 + BMI270六轴陀螺仪 │
└─────────┴─────────┴─────────┴─────────────────────────────────────────────┘

┌─────────────────────────────────────────────────────────────────────────────┐
│ SPI资源 (Serial Peripheral Interface) - 高速串行外设接口                    │
├─────────┬─────────┬─────────┬─────────┬─────────────────────────────────────┤
│ SPI总线 │  SCLK   │  MOSI   │  MISO   │              用途                    │
├─────────┼─────────┼─────────┼─────────┼─────────────────────────────────────┤
│  SPI1   │  PA17   │  PB15   │  PA16   │  OLED显示屏 (1MHz, Mode3, CPOL=1)   │
└─────────┴─────────┴─────────┴─────────┴─────────────────────────────────────┘

┌─────────────────────────────────────────────────────────────────────────────┐
│ PWM资源 (Pulse Width Modulation) - 脉冲宽度调制输出                         │
├─────────┬─────────┬─────────┬─────────────────────────────────────────────┤
│ PWM模块 │  CCP0   │  CCP1   │              用途                            │
├─────────┼─────────┼─────────┼─────────────────────────────────────────────┤
│ TIMA0   │  PA0    │  PA1    │  左轮电机驱动 (通道A/B, 预分频:8, 计数:3000) │
│ TIMG8   │  PA7    │  PA22   │  右轮电机驱动 (通道A/B, 预分频:8, 计数:3000) │
│ TIMG7   │  PA23*  │  PA31   │  蜂鸣器PWM输出 (LFCLK时钟源)                │
│         │(VREF+冲突)│        │  *注意: PA23与VREF+引脚冲突，不可同时使用    │
└─────────┴─────────┴─────────┴─────────────────────────────────────────────┘

┌─────────────────────────────────────────────────────────────────────────────┐
│ ADC资源 (Analog-to-Digital Converter) - 模拟数字转换                        │
│ 感为科技无MCU循迹模块 (74HC4051多路复用器)                                  │
├─────────┬─────────┬─────────┬─────────┬─────────────────────────────────────┤
│ ADC输出 │   D0    │   D1    │   D2    │              用途                    │
├─────────┼─────────┼─────────┼─────────┼─────────────────────────────────────┤
│  PA27   │  PA24   │  PA30   │  PA29   │  循迹传感器阵列 (8路模拟输入选择)    │
│         │         │         │         │  通过74HC4051实现1路ADC扩展8路模拟   │
└─────────┴─────────┴─────────┴─────────┴─────────────────────────────────────┘

┌─────────────────────────────────────────────────────────────────────────────┐
│ 调试接口 (Debug Interface) - SWD串行线调试                                  │
├─────────┬─────────────────────────────────────────────────────────────────┤
│  引脚   │                        功能                                      │
├─────────┼─────────────────────────────────────────────────────────────────┤
│  PA20   │  SWCLK - SWD调试时钟 (Serial Wire Debug Clock)                  │
│  PA19   │  SWDIO - SWD调试数据 (Serial Wire Debug Input/Output)           │
└─────────┴─────────────────────────────────────────────────────────────────┘

*/

/*
 * 资源使用注意事项:
 * 1. UART波特率已针对各模块进行优化配置
 * 2. GPIO中断优先级需根据实际应用场景配置
 * 3. I2C设备地址冲突检查: PCA9555, MPU6050, VL53L1X
 * 4. SPI时序参数已针对OLED显示屏优化
 * 5. PWM频率计算: PWM_FREQ = SYSCLK / (预分频 × 计数值)
 * 6. ADC采样率需根据循迹精度要求调整
 * 7. PA23引脚与VREF+功能冲突，使用时需注意
 * 
 * 作者: [JamieK32]
 * 日期: [2025-7-22]  
 * 版本: v1.1
 * 芯片: MSPM0G3507 (Arm Cortex-M0+, 80MHz)
 */
 

#include "common_include.h"
#include "log_config.h" // 日志配置
#include "log.h"
#include "task22c_config.h"

void system_init(void) 
{
    SYSCFG_DL_init();
		beep_init();
		systick_init();
		car_init();
}

void main_task_init(void) 
{	
	
#if CURRENT_IMU == WIT_GYRO
		wit_imu_init();
#elif (CURRENT_IMU == MPU6050_GYRO)
		mpu6050_hardware_init();
		while (mpu_dmp_init()) {}
#elif (CURRENT_IMU == IMU660RA_GYRO)
		extern Attitude_module attitude;
		init_attitude(&attitude, 0.005f);
#else
	
#endif
		VL53L1_Read_Init();
		bluetooth_init();
	
		menu_init_and_create();
		init_task_table();
    car_init();
		gray_detection_init();
		create_periodic_event_task(); // 初始化任务调度器
}

void test_task(void) 
{	
	vl53l1_test();
}

int main(void) 
{
    system_init();
    
#if UNIT_TEST_MODE    // 是否使能单元测试功能
		test_task();
		while (1) {
		
		}
#else
		main_task_init();
#endif

    while (1) {
        periodic_event_task_process(); // 处理所有任务
    }

    return 0;
}


void HardFault_Handler(void) 
{
    log_e("!!! Unhandled Interrupt HardFault_Handler !!!\n");
    
    play_alert_blocking(3, COLOR_RED);
    
    while (1)
    {
    }
}

